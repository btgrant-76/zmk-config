## config/west.yml
```yaml
manifest:
  remotes:
    - name: zmkfirmware
      url-base: https://github.com/zmkfirmware
    - name: urob
      url-base: https://github.com/urob
    - name: jlw
      url-base: https://github.com/josh-l-wang
    - name: petejohanson
      url-base: https://github.com/petejohanson
    - name: btgrant-76
      url-base:  https://github.com/btgrant-76
    - name: badjeff
      url-base: https://github.com/badjeff
    - name: carrefinho
      url-base: https://github.com/carrefinho
    - name: caksoylar
      url-base: https://github.com/caksoylar
  projects:
    - name: zmk
#      remote: zmkfirmware
#      revision: v0.3
      remote: petejohanson
      revision: core/move-to-zephyr-4-1
      import: app/west.yml
    - name: zmk-leader-key
      remote: urob
#      revision: v0.3.0
      revision: main
    - name: zmk-config-jlw
      remote: jlw
      revision: main # this should get pinned to 0.3
    - name: le-chiffre-stm32-zmk-config
      remote: petejohanson
      revision: main
    - name:  zmk-config-adeptble
      remote: btgrant-76
      revision: main # TODO tag this to v0.3
    - name: zmk-pmw3610-driver
      remote: badjeff
      revision: zmk-0.3
    - name: forager-zmk-module
      remote: carrefinho
      revision: main
    - name: zmk-rgbled-widget
      remote: caksoylar
      revision: main
  self:
    path: config
```
